#define ___ &trans

#define l_any   -1
#define l_alpha  0
#define l_qwerty 1
#define l_nav    2
#define l_sym    3
#define l_fn     4
#define l_num    5
#define l_bt     6

&mt {
    tapping-term-ms = <170>;
};

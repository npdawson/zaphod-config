#include <behaviors.dtsi>
#include <dt-bindings/zmk/keys.h>
#include <dt-bindings/zmk/bt.h>

#include "config.dtsi"

/ {
#include "behaviors.dtsi"
#include "macros.dtsi"
#include "combos.dtsi"

    keymap {
        compatible = "zmk,keymap";
#include "HD-Vb-keymap.dtsi"  // Hands Down Vibranium layer
#include "qwerty-keymap.dtsi"  // QWERTY layer
#include "layers.dtsi" // all the other layers

    };
};
